
qcom,batterydata-Hydra-2650mAh-4p38V-SMP {
	qcom,battery-type = "batterydata_Hydra_2650mAh_4p38V_SMP";
	qcom,batt-id-kohm = <51>;
	qcom,chg-term-ua = <173000>;
	qcom,default-rbatt-mohm = <124>;
	qcom,fcc-mah = <2650>;
	qcom,max-voltage-uv = <4380000>;
	qcom,rbatt-capacitive-mohm = <50>;

	qcom,fcc-temp-lut {
		qcom,lut-col-legend = <(-20) 0 25 40 60>;
		qcom,lut-data = <2483 2490 2490 2487 2479>;
	};

	qcom,pc-temp-ocv-lut {
		qcom,lut-col-legend = <(-20) 0 25 40 60>;
		qcom,lut-row-legend = <100 95 90 85 80>,
					<75 70 65 60 55>,
					<50 45 40 35 30>,
					<25 20 16 13 11>,
					<10 9 8 7 6>,
					<5 4 3 2 1>,
					<0>;
		qcom,lut-data = <4359 4360 4354 4348 4340>,
				<4242 4280 4284 4282 4277>,
				<4169 4218 4226 4223 4219>,
				<4110 4162 4169 4167 4163>,
				<4056 4109 4114 4113 4109>,
				<3980 4060 4064 4062 4058>,
				<3924 3996 4016 4016 4012>,
				<3882 3944 3973 3972 3970>,
				<3846 3904 3926 3928 3926>,
				<3822 3868 3880 3882 3880>,
				<3806 3838 3846 3846 3845>,
				<3792 3812 3822 3822 3821>,
				<3780 3794 3802 3804 3802>,
				<3766 3780 3786 3787 3785>,
				<3754 3770 3772 3770 3766>,
				<3740 3758 3756 3749 3738>,
				<3724 3741 3739 3730 3718>,
				<3709 3720 3718 3709 3696>,
				<3694 3706 3701 3694 3682>,
				<3682 3696 3690 3683 3672>,
				<3674 3692 3686 3680 3669>,
				<3664 3690 3684 3678 3668>,
				<3654 3686 3683 3676 3666>,
				<3642 3679 3678 3671 3664>,
				<3622 3668 3666 3658 3640>,
				<3601 3650 3648 3638 3617>,
				<3568 3612 3602 3594 3572>,
				<3520 3556 3544 3531 3510>,
				<3448 3472 3458 3448 3426>,
				<3319 3350 3338 3326 3294>,
				<3000 3000 3000 3000 3000>;
	};

	qcom,rbatt-sf-lut {
		qcom,lut-col-legend = <(-20) 0 25 40 60>;
		qcom,lut-row-legend = <100 95 90 85 80>,
					<75 70 65 60 55>,
					<50 45 40 35 30>,
					<25 20 16 13 11>,
					<10 9 8 7 6>,
					<5 4 3 2 1>;
		qcom,lut-data = <1540 299 99 80 72>,
				<1540 299 99 80 72>,
				<1397 300 101 80 73>,
				<1305 302 103 81 73>,
				<1248 303 106 84 75>,
				<1156 315 110 86 77>,
				<1114 292 117 90 79>,
				<1097 274 127 97 83>,
				<1092 268 123 98 85>,
				<1105 262 106 89 79>,
				<1135 261 98 79 73>,
				<1184 265 99 81 73>,
				<1253 268 102 84 75>,
				<1332 277 104 87 79>,
				<1419 294 105 87 79>,
				<1506 320 102 81 74>,
				<1605 358 102 81 74>,
				<1719 390 103 82 75>,
				<1954 429 104 82 75>,
				<2197 462 105 82 75>,
				<2353 490 107 83 76>,
				<2580 527 111 86 80>,
				<2806 563 115 90 84>,
				<3034 605 119 92 89>,
				<3426 654 123 91 83>,
				<3801 677 123 90 77>,
				<4102 656 114 86 77>,
				<5182 742 119 90 81>,
				<6960 906 133 98 91>,
				<12134 1234 169 131 129>;
	};
};
