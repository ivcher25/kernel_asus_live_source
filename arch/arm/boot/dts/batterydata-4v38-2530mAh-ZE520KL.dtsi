
qcom,batterydata_Leo_2530mah_4p38V_SMP {
	qcom,battery-type = "batterydata_Leo_2530mah_4p38V_SMP";
	qcom,batt-id-kohm = <51>;
	qcom,chg-term-ua = <120000>;
	qcom,default-rbatt-mohm = <142>;
	qcom,fcc-mah = <2530>;
	qcom,max-voltage-uv = <4380000>;
	qcom,rbatt-capacitive-mohm = <50>;

	qcom,fcc-temp-lut {
		qcom,lut-col-legend = <0 10 25 40 50>;
		qcom,lut-data = <2510 2528 2533 2528 2528>;
	};

	qcom,pc-temp-ocv-lut {
		qcom,lut-col-legend = <0 10 25 40 50>;
		qcom,lut-row-legend = <100 95 90 85 80>,
					<75 70 65 60 55>,
					<50 45 40 35 30>,
					<25 20 16 13 11>,
					<10 9 8 7 6>,
					<5 4 3 2 1>,
					<0>;
		qcom,lut-data = <4362 4361 4358 4352 4350>,
				<4279 4290 4290 4287 4288>,
				<4216 4230 4231 4229 4230>,
				<4159 4172 4174 4172 4172>,
				<4105 4118 4119 4117 4117>,
				<4059 4069 4068 4065 4065>,
				<3988 4009 4016 4016 4016>,
				<3938 3953 3970 3972 3974>,
				<3896 3908 3922 3928 3930>,
				<3860 3870 3874 3876 3877>,
				<3829 3840 3844 3845 3846>,
				<3802 3816 3820 3822 3822>,
				<3789 3796 3800 3802 3802>,
				<3778 3780 3784 3786 3786>,
				<3768 3770 3770 3769 3768>,
				<3755 3758 3756 3749 3743>,
				<3737 3740 3737 3730 3724>,
				<3716 3718 3714 3708 3702>,
				<3698 3700 3694 3687 3682>,
				<3688 3690 3688 3682 3677>,
				<3684 3686 3686 3682 3676>,
				<3681 3684 3685 3680 3675>,
				<3676 3682 3683 3678 3673>,
				<3671 3678 3678 3675 3670>,
				<3662 3672 3666 3664 3658>,
				<3642 3650 3634 3632 3624>,
				<3604 3608 3582 3584 3576>,
				<3547 3548 3516 3521 3512>,
				<3468 3468 3424 3436 3428>,
				<3350 3348 3292 3316 3306>,
				<3000 3000 3000 3000 3000>;
	};

	qcom,rbatt-sf-lut {
		qcom,lut-col-legend = <0 10 25 40 50>;
		qcom,lut-row-legend = <100 95 90 85 80>,
					<75 70 65 60 55>,
					<50 45 40 35 30>,
					<25 20 16 13 11>,
					<10 9 8 7 6>,
					<5 4 3 2 1>;
		qcom,lut-data = <375 196 100 78 73>,
				<375 196 100 78 73>,
				<375 195 102 79 73>,
				<370 193 104 81 75>,
				<370 196 108 85 77>,
				<385 206 114 87 80>,
				<344 208 120 90 83>,
				<325 185 126 98 88>,
				<313 170 118 101 94>,
				<305 163 99 80 75>,
				<301 163 96 78 73>,
				<300 165 99 80 75>,
				<325 165 101 83 77>,
				<359 167 105 86 80>,
				<397 177 104 84 80>,
				<444 194 104 80 74>,
				<503 211 104 80 75>,
				<558 227 106 82 75>,
				<615 244 106 79 73>,
				<661 256 108 80 75>,
				<670 247 108 82 75>,
				<659 258 111 83 77>,
				<696 273 116 86 80>,
				<746 293 122 90 85>,
				<803 318 125 91 83>,
				<866 331 120 85 77>,
				<946 353 124 85 79>,
				<1066 411 136 90 82>,
				<1270 499 158 100 93>,
				<1915 678 315 157 141>;
	};
};
