/* Copyright (c) 2013, The Linux Foundation. All rights reserved.
 *
 * This program is free software; you can redistribute it and/or modify
 * it under the terms of the GNU General Public License version 2 and
 * only version 2 as published by the Free Software Foundation.
 *
 * This program is distributed in the hope that it will be useful,
 * but WITHOUT ANY WARRANTY; without even the implied warranty of
 * MERCHANTABILITY or FITNESS FOR A PARTICULAR PURPOSE.  See the
 * GNU General Public License for more details.
 */

/*---------------------------------------------------------------------------
 * This file is autogenerated file using gcdb parser. Please do not edit it.
 * Update input XML file to add a new entry or update variable in this file
 * VERSION = "1.0"
 *---------------------------------------------------------------------------*/
&mdss_mdp {
	dsi_txd_otm1289a_720p_video: qcom,mdss_dsi_txd_otm1289a_720p_video {
		qcom,mdss-dsi-panel-name = "TXD otm1289a 720p video mode dsi panel";
		qcom,mdss-dsi-panel-controller = <&mdss_dsi0>;
		qcom,mdss-dsi-panel-type = "dsi_video_mode";
		qcom,mdss-dsi-panel-destination = "display_1";
		qcom,mdss-dsi-panel-framerate = <60>;
		qcom,mdss-dsi-virtual-channel-id = <0>;
		qcom,mdss-dsi-stream = <0>;
		qcom,mdss-dsi-panel-width = <720>;
		qcom,mdss-dsi-panel-height = <1280>;
		qcom,mdss-pan-physical-width-dimension = <62>;
		qcom,mdss-pan-physical-height-dimension = <110>;
		qcom,mdss-dsi-h-front-porch = <40>;
		qcom,mdss-dsi-h-back-porch = <40>;
		qcom,mdss-dsi-h-pulse-width = <12>;
		qcom,mdss-dsi-h-sync-skew = <0>;
		qcom,mdss-dsi-v-back-porch = <12>;
		qcom,mdss-dsi-v-front-porch = <12>;
		qcom,mdss-dsi-v-pulse-width = <6>;
		qcom,mdss-dsi-h-left-border = <0>;
		qcom,mdss-dsi-h-right-border = <0>;
		qcom,mdss-dsi-v-top-border = <0>;
		qcom,mdss-dsi-v-bottom-border = <0>;
		qcom,mdss-dsi-bpp = <24>;
		qcom,mdss-dsi-color-order = <0>;
		qcom,mdss-dsi-underflow-color = <0xff>;
		qcom,mdss-dsi-border-color = <0>;
		qcom,mdss-dsi-on-command = [39 01 00 00 00 00 02 00 00
		29 01 00 00 00 00 04 ff 12 89 01
		15 01 00 00 00 00 02 00 80
		15 01 00 00 00 00 02 ff 12
		15 01 00 00 00 00 02 00 81
		15 01 00 00 00 00 02 ff 89
		15 01 00 00 00 00 02 00 90
		15 01 00 00 00 00 02 ff b0
		15 01 00 00 00 00 02 00 80
		15 01 00 00 00 00 02 c0 4a
		15 01 00 00 00 00 02 00 81
		15 01 00 00 00 00 02 c0 00
		15 01 00 00 00 00 02 00 82
		15 01 00 00 00 00 02 c0 10
		15 01 00 00 00 00 02 00 83
		15 01 00 00 00 00 02 c0 10
		15 01 00 00 00 00 02 00 84
		15 01 00 00 00 00 02 c0 96
		15 01 00 00 00 00 02 00 85
		15 01 00 00 00 00 02 c0 01
		15 01 00 00 00 00 02 00 86
		15 01 00 00 00 00 02 c0 68
		15 01 00 00 00 00 02 00 87
		15 01 00 00 00 00 02 c0 40
		15 01 00 00 00 00 02 00 90
		15 01 00 00 00 00 02 c0 3b
		15 01 00 00 00 00 02 00 91
		15 01 00 00 00 00 02 c0 01
		15 01 00 00 00 00 02 00 92
		15 01 00 00 00 00 02 c0 09
		15 01 00 00 00 00 02 00 8c
		15 01 00 00 00 00 02 c0 00
		15 01 00 00 00 00 02 00 80
		15 01 00 00 00 00 02 c1 33
		15 01 00 00 00 00 02 00 85
		15 01 00 00 00 00 02 c5 0a
		15 01 00 00 00 00 02 00 86
		15 01 00 00 00 00 02 c5 0a
		15 01 00 00 00 00 02 00 87
		15 01 00 00 00 00 02 c5 46
		15 01 00 00 00 00 02 00 00
		15 01 00 00 00 00 02 d8 27
		15 01 00 00 00 00 02 00 01
		15 01 00 00 00 00 02 d8 27
		15 01 00 00 00 00 02 00 84
		15 01 00 00 00 00 02 c4 02
		15 01 00 00 00 00 02 00 93
		15 01 00 00 00 00 02 c4 04
		15 01 00 00 00 00 02 00 96
		15 01 00 00 00 00 02 f5 e7
		15 01 00 00 00 00 02 00 a0
		15 01 00 00 00 00 02 f5 4a
		15 01 00 00 00 00 02 00 8a
		15 01 00 00 00 00 02 c0 11
		15 01 00 00 00 00 02 00 83
		15 01 00 00 00 00 02 F5 81
		15 01 00 00 00 00 02 00 90
		15 01 00 00 00 00 02 c4 96
		15 01 00 00 00 00 02 00 91
		15 01 00 00 00 00 02 c4 05
		15 01 00 00 00 00 02 00 80
		15 01 00 00 00 00 02 cb 14
		15 01 00 00 00 00 02 00 81
		15 01 00 00 00 00 02 cb 14
		15 01 00 00 00 00 02 00 82
		15 01 00 00 00 00 02 cb 14
		15 01 00 00 00 00 02 00 83
		15 01 00 00 00 00 02 cb 14
		15 01 00 00 00 00 02 00 84
		15 01 00 00 00 00 02 cb 14
		15 01 00 00 00 00 02 00 85
		15 01 00 00 00 00 02 cb 00
		15 01 00 00 00 00 02 00 86
		15 01 00 00 00 00 02 cb 00
		15 01 00 00 00 00 02 00 87
		15 01 00 00 00 00 02 cb 00
		15 01 00 00 00 00 02 00 88
		15 01 00 00 00 00 02 cb 00
		15 01 00 00 00 00 02 00 89
		15 01 00 00 00 00 02 cb 00
		15 01 00 00 00 00 02 00 8a
		15 01 00 00 00 00 02 cb 00
		15 01 00 00 00 00 02 00 8b
		15 01 00 00 00 00 02 cb 00
		15 01 00 00 00 00 02 00 8c
		15 01 00 00 00 00 02 cb 00
		15 01 00 00 00 00 02 00 8d
		15 01 00 00 00 00 02 cb 00
		15 01 00 00 00 00 02 00 8e
		15 01 00 00 00 00 02 cb 00
		15 01 00 00 00 00 02 00 90
		15 01 00 00 00 00 02 cb fc
		15 01 00 00 00 00 02 00 91
		15 01 00 00 00 00 02 cb fc
		15 01 00 00 00 00 02 00 92
		15 01 00 00 00 00 02 cb fc
		15 01 00 00 00 00 02 00 93
		15 01 00 00 00 00 02 cb 00
		15 01 00 00 00 00 02 00 94
		15 01 00 00 00 00 02 cb 14
		15 01 00 00 00 00 02 00 95
		15 01 00 00 00 00 02 cb 14
		15 01 00 00 00 00 02 00 96
		15 01 00 00 00 00 02 cb 14
		15 01 00 00 00 00 02 00 80
		15 01 00 00 00 00 02 cc 02
		15 01 00 00 00 00 02 00 81
		15 01 00 00 00 00 02 cc 0a
		15 01 00 00 00 00 02 00 82
		15 01 00 00 00 00 02 cc 0c
		15 01 00 00 00 00 02 00 83
		15 01 00 00 00 00 02 cc 0e
		15 01 00 00 00 00 02 00 84
		15 01 00 00 00 00 02 cc 10
		15 01 00 00 00 00 02 00 85
		15 01 00 00 00 00 02 cc 00
		15 01 00 00 00 00 02 00 86
		15 01 00 00 00 00 02 cc 00
		15 01 00 00 00 00 02 00 87
		15 01 00 00 00 00 02 cc 00
		15 01 00 00 00 00 02 00 88
		15 01 00 00 00 00 02 cc 00
		15 01 00 00 00 00 02 00 89
		15 01 00 00 00 00 02 cc 00
		15 01 00 00 00 00 02 00 8a
		15 01 00 00 00 00 02 cc 00
		15 01 00 00 00 00 02 00 8b
		15 01 00 00 00 00 02 cc 00
		15 01 00 00 00 00 02 00 8c
		15 01 00 00 00 00 02 cc 00
		15 01 00 00 00 00 02 00 8d
		15 01 00 00 00 00 02 cc 00
		15 01 00 00 00 00 02 00 90
		15 01 00 00 00 00 02 cc 00
		15 01 00 00 00 00 02 00 91
		15 01 00 00 00 00 02 cc 00
		15 01 00 00 00 00 02 00 92
		15 01 00 00 00 00 02 cc 00
		15 01 00 00 00 00 02 00 93
		15 01 00 00 00 00 02 cc 00
		15 01 00 00 00 00 02 00 94
		15 01 00 00 00 00 02 cc 1e
		15 01 00 00 00 00 02 00 95
		15 01 00 00 00 00 02 cc 1d
		15 01 00 00 00 00 02 00 96
		15 01 00 00 00 00 02 cc 06
		15 01 00 00 00 00 02 00 97
		15 01 00 00 00 00 02 cc 01
		15 01 00 00 00 00 02 00 98
		15 01 00 00 00 00 02 cc 09
		15 01 00 00 00 00 02 00 99
		15 01 00 00 00 00 02 cc 0b
		15 01 00 00 00 00 02 00 9a
		15 01 00 00 00 00 02 cc 0d
		15 01 00 00 00 00 02 00 9b
		15 01 00 00 00 00 02 cc 0f
		15 01 00 00 00 00 02 00 9c
		15 01 00 00 00 00 02 cc 00
		15 01 00 00 00 00 02 00 9d
		15 01 00 00 00 00 02 cc 00
		15 01 00 00 00 00 02 00 9e
		15 01 00 00 00 00 02 cc 00
		15 01 00 00 00 00 02 00 a0
		15 01 00 00 00 00 02 cc 00
		15 01 00 00 00 00 02 00 a1
		15 01 00 00 00 00 02 cc 00
		15 01 00 00 00 00 02 00 a2
		15 01 00 00 00 00 02 cc 00
		15 01 00 00 00 00 02 00 a3
		15 01 00 00 00 00 02 cc 00
		15 01 00 00 00 00 02 00 a4
		15 01 00 00 00 00 02 cc 00
		15 01 00 00 00 00 02 00 a5
		15 01 00 00 00 00 02 cc 00
		15 01 00 00 00 00 02 00 a6
		15 01 00 00 00 00 02 cc 00
		15 01 00 00 00 00 02 00 a7
		15 01 00 00 00 00 02 cc 00
		15 01 00 00 00 00 02 00 a8
		15 01 00 00 00 00 02 cc 00
		15 01 00 00 00 00 02 00 a9
		15 01 00 00 00 00 02 cc 00
		15 01 00 00 00 00 02 00 aa
		15 01 00 00 00 00 02 cc 1e
		15 01 00 00 00 00 02 00 ab
		15 01 00 00 00 00 02 cc 1d
		15 01 00 00 00 00 02 00 ac
		15 01 00 00 00 00 02 cc 05
		15 01 00 00 00 00 02 00 b0
		15 01 00 00 00 00 02 cc 05
		15 01 00 00 00 00 02 00 b1
		15 01 00 00 00 00 02 cc 0f
		15 01 00 00 00 00 02 00 b2
		15 01 00 00 00 00 02 cc 0d
		15 01 00 00 00 00 02 00 b3
		15 01 00 00 00 00 02 cc 0b
		15 01 00 00 00 00 02 00 b4
		15 01 00 00 00 00 02 cc 09
		15 01 00 00 00 00 02 00 b5
		15 01 00 00 00 00 02 cc 00
		15 01 00 00 00 00 02 00 b6
		15 01 00 00 00 00 02 cc 00
		15 01 00 00 00 00 02 00 b7
		15 01 00 00 00 00 02 cc 00
		15 01 00 00 00 00 02 00 b8
		15 01 00 00 00 00 02 cc 00
		15 01 00 00 00 00 02 00 b9
		15 01 00 00 00 00 02 cc 00
		15 01 00 00 00 00 02 00 ba
		15 01 00 00 00 00 02 cc 00
		15 01 00 00 00 00 02 00 bb
		15 01 00 00 00 00 02 cc 00
		15 01 00 00 00 00 02 00 bc
		15 01 00 00 00 00 02 cc 00
		15 01 00 00 00 00 02 00 bd
		15 01 00 00 00 00 02 cc 00
		15 01 00 00 00 00 02 00 c0
		15 01 00 00 00 00 02 cc 00
		15 01 00 00 00 00 02 00 c1
		15 01 00 00 00 00 02 cc 00
		15 01 00 00 00 00 02 00 c2
		15 01 00 00 00 00 02 cc 00
		15 01 00 00 00 00 02 00 c3
		15 01 00 00 00 00 02 cc 00
		15 01 00 00 00 00 02 00 c4
		15 01 00 00 00 00 02 cc 1d
		15 01 00 00 00 00 02 00 c5
		15 01 00 00 00 00 02 cc 1e
		15 01 00 00 00 00 02 00 c6
		15 01 00 00 00 00 02 cc 01
		15 01 00 00 00 00 02 00 c7
		15 01 00 00 00 00 02 cc 06
		15 01 00 00 00 00 02 00 c8
		15 01 00 00 00 00 02 cc 10
		15 01 00 00 00 00 02 00 c9
		15 01 00 00 00 00 02 cc 0e
		15 01 00 00 00 00 02 00 ca
		15 01 00 00 00 00 02 cc 0c
		15 01 00 00 00 00 02 00 cb
		15 01 00 00 00 00 02 cc 0a
		15 01 00 00 00 00 02 00 cc
		15 01 00 00 00 00 02 cc 00
		15 01 00 00 00 00 02 00 cd
		15 01 00 00 00 00 02 cc 00
		15 01 00 00 00 00 02 00 ce
		15 01 00 00 00 00 02 cc 00
		15 01 00 00 00 00 02 00 d0
		15 01 00 00 00 00 02 cc 00
		15 01 00 00 00 00 02 00 d1
		15 01 00 00 00 00 02 cc 00
		15 01 00 00 00 00 02 00 d2
		15 01 00 00 00 00 02 cc 00
		15 01 00 00 00 00 02 00 d3
		15 01 00 00 00 00 02 cc 00
		15 01 00 00 00 00 02 00 d4
		15 01 00 00 00 00 02 cc 00
		15 01 00 00 00 00 02 00 d5
		15 01 00 00 00 00 02 cc 00
		15 01 00 00 00 00 02 00 d6
		15 01 00 00 00 00 02 cc 00
		15 01 00 00 00 00 02 00 d7
		15 01 00 00 00 00 02 cc 00
		15 01 00 00 00 00 02 00 d8
		15 01 00 00 00 00 02 cc 00
		15 01 00 00 00 00 02 00 d9
		15 01 00 00 00 00 02 cc 00
		15 01 00 00 00 00 02 00 da
		15 01 00 00 00 00 02 cc 1d
		15 01 00 00 00 00 02 00 db
		15 01 00 00 00 00 02 cc 1e
		15 01 00 00 00 00 02 00 dc
		15 01 00 00 00 00 02 cc 02
		15 01 00 00 00 00 02 00 80
		15 01 00 00 00 00 02 ce 87
		15 01 00 00 00 00 02 00 81
		15 01 00 00 00 00 02 ce 05
		15 01 00 00 00 00 02 00 82
		15 01 00 00 00 00 02 ce 10
		15 01 00 00 00 00 02 00 83
		15 01 00 00 00 00 02 ce 86
		15 01 00 00 00 00 02 00 84
		15 01 00 00 00 00 02 ce 00
		15 01 00 00 00 00 02 00 85
		15 01 00 00 00 00 02 ce 00
		15 01 00 00 00 00 02 00 90
		15 01 00 00 00 00 02 ce 34
		15 01 00 00 00 00 02 00 91
		15 01 00 00 00 00 02 ce ff
		15 01 00 00 00 00 02 00 92
		15 01 00 00 00 00 02 ce 10
		15 01 00 00 00 00 02 00 93
		15 01 00 00 00 00 02 ce 05
		15 01 00 00 00 00 02 00 94
		15 01 00 00 00 00 02 ce 00
		15 01 00 00 00 00 02 00 95
		15 01 00 00 00 00 02 ce 00
		15 01 00 00 00 00 02 00 96
		15 01 00 00 00 00 02 ce 00
		15 01 00 00 00 00 02 00 97
		15 01 00 00 00 00 02 ce 00
		15 01 00 00 00 00 02 00 98
		15 01 00 00 00 00 02 ce 00
		15 01 00 00 00 00 02 00 a0
		15 01 00 00 00 00 02 ce 30
		15 01 00 00 00 00 02 00 a1
		15 01 00 00 00 00 02 ce 83
		15 01 00 00 00 00 02 00 a2
		15 01 00 00 00 00 02 ce 88
		15 01 00 00 00 00 02 00 a3
		15 01 00 00 00 00 02 ce 00
		15 01 00 00 00 00 02 00 a4
		15 01 00 00 00 00 02 ce 20
		15 01 00 00 00 00 02 00 a5
		15 01 00 00 00 00 02 ce 00
		15 01 00 00 00 00 02 00 a6
		15 01 00 00 00 00 02 ce 82
		15 01 00 00 00 00 02 00 a7
		15 01 00 00 00 00 02 ce 87
		15 01 00 00 00 00 02 00 a8
		15 01 00 00 00 00 02 ce 00
		15 01 00 00 00 00 02 00 a9
		15 01 00 00 00 00 02 ce 81
		15 01 00 00 00 00 02 00 aa
		15 01 00 00 00 00 02 ce 86
		15 01 00 00 00 00 02 00 ab
		15 01 00 00 00 00 02 ce 00
		15 01 00 00 00 00 02 00 ac
		15 01 00 00 00 00 02 ce 80
		15 01 00 00 00 00 02 00 ad
		15 01 00 00 00 00 02 ce 85
		15 01 00 00 00 00 02 00 ae
		15 01 00 00 00 00 02 ce 00
		15 01 00 00 00 00 02 00 b0
		15 01 00 00 00 00 02 ce 30
		15 01 00 00 00 00 02 00 b1
		15 01 00 00 00 00 02 ce 00
		15 01 00 00 00 00 02 00 b2
		15 01 00 00 00 00 02 ce 84
		15 01 00 00 00 00 02 00 b3
		15 01 00 00 00 00 02 ce 00
		15 01 00 00 00 00 02 00 b4
		15 01 00 00 00 00 02 ce 20
		15 01 00 00 00 00 02 00 b5
		15 01 00 00 00 00 02 ce 00
		15 01 00 00 00 00 02 00 b6
		15 01 00 00 00 00 02 ce 01
		15 01 00 00 00 00 02 00 b7
		15 01 00 00 00 00 02 ce 83
		15 01 00 00 00 00 02 00 b8
		15 01 00 00 00 00 02 ce 00
		15 01 00 00 00 00 02 00 b9
		15 01 00 00 00 00 02 ce 02
		15 01 00 00 00 00 02 00 ba
		15 01 00 00 00 00 02 ce 82
		15 01 00 00 00 00 02 00 bb
		15 01 00 00 00 00 02 ce 00
		15 01 00 00 00 00 02 00 bc
		15 01 00 00 00 00 02 ce 03
		15 01 00 00 00 00 02 00 bd
		15 01 00 00 00 00 02 ce 81
		15 01 00 00 00 00 02 00 be
		15 01 00 00 00 00 02 ce 00
		15 01 00 00 00 00 02 00 f0
		15 01 00 00 00 00 02 ce 01
		15 01 00 00 00 00 02 00 f1
		15 01 00 00 00 00 02 ce 20
		15 01 00 00 00 00 02 00 f2
		15 01 00 00 00 00 02 ce 01
		15 01 00 00 00 00 02 00 f3
		15 01 00 00 00 00 02 ce 01
		15 01 00 00 00 00 02 00 f4
		15 01 00 00 00 00 02 ce 00
		15 01 00 00 00 00 02 00 f5
		15 01 00 00 00 00 02 ce 00
		15 01 00 00 00 00 02 00 00
		15 01 00 00 00 00 02 e1 00
		15 01 00 00 00 00 02 00 01
		15 01 00 00 00 00 02 e1 1a
		15 01 00 00 00 00 02 00 02
		15 01 00 00 00 00 02 e1 28
		15 01 00 00 00 00 02 00 03
		15 01 00 00 00 00 02 e1 3b
		15 01 00 00 00 00 02 00 04
		15 01 00 00 00 00 02 e1 49
		15 01 00 00 00 00 02 00 05
		15 01 00 00 00 00 02 e1 69
		15 01 00 00 00 00 02 00 06
		15 01 00 00 00 00 02 e1 68
		15 01 00 00 00 00 02 00 07
		15 01 00 00 00 00 02 e1 80
		15 01 00 00 00 00 02 00 08
		15 01 00 00 00 00 02 e1 75
		15 01 00 00 00 00 02 00 09
		15 01 00 00 00 00 02 e1 61
		15 01 00 00 00 00 02 00 0a
		15 01 00 00 00 00 02 e1 69
		15 01 00 00 00 00 02 00 0b
		15 01 00 00 00 00 02 e1 50
		15 01 00 00 00 00 02 00 0c
		15 01 00 00 00 00 02 e1 3a
		15 01 00 00 00 00 02 00 0d
		15 01 00 00 00 00 02 e1 27
		15 01 00 00 00 00 02 00 0e
		15 01 00 00 00 00 02 e1 15
		15 01 00 00 00 00 02 00 0f
		15 01 00 00 00 00 02 e1 00
		15 01 00 00 00 00 02 00 00
		15 01 00 00 00 00 02 e2 00
		15 01 00 00 00 00 02 00 01
		15 01 00 00 00 00 02 e2 1a
		15 01 00 00 00 00 02 00 02
		15 01 00 00 00 00 02 e2 28
		15 01 00 00 00 00 02 00 03
		15 01 00 00 00 00 02 e2 3c
		15 01 00 00 00 00 02 00 04
		15 01 00 00 00 00 02 e2 49
		15 01 00 00 00 00 02 00 05
		15 01 00 00 00 00 02 e2 69
		15 01 00 00 00 00 02 00 06
		15 01 00 00 00 00 02 e2 68
		15 01 00 00 00 00 02 00 07
		15 01 00 00 00 00 02 e2 80
		15 01 00 00 00 00 02 00 08
		15 01 00 00 00 00 02 e2 75
		15 01 00 00 00 00 02 00 09
		15 01 00 00 00 00 02 e2 61
		15 01 00 00 00 00 02 00 0a
		15 01 00 00 00 00 02 e2 69
		15 01 00 00 00 00 02 00 0b
		15 01 00 00 00 00 02 e2 50
		15 01 00 00 00 00 02 00 0c
		15 01 00 00 00 00 02 e2 3a
		15 01 00 00 00 00 02 00 0d
		15 01 00 00 00 00 02 e2 27
		15 01 00 00 00 00 02 00 0e
		15 01 00 00 00 00 02 e2 15
		15 01 00 00 00 00 02 00 0f
		15 01 00 00 00 00 02 e2 00
		15 01 00 00 00 00 02 00 00
		15 01 00 00 00 00 02 ff ff
		15 01 00 00 00 00 02 00 01
		15 01 00 00 00 00 02 ff ff
		15 01 00 00 00 00 02 00 02
		15 01 00 00 00 00 02 ff ff
		39 01 00 00 00 00 02 53 2C
		//29 01 00 00 00 00 03 51 FF 03
		05 01 00 00 c8 00 02 11 00
		05 01 00 00 00 00 02 29 00];
		qcom,mdss-dsi-off-command = [15 01 00 00 82 00 02 28 00
					15 01 00 00 0C 00 02 10 00];
		qcom,mdss-dsi-on-command-state = "dsi_lp_mode";
		qcom,mdss-dsi-off-command-state = "dsi_lp_mode";
		qcom,mdss-dsi-h-sync-pulse = <1>;
		qcom,mdss-dsi-traffic-mode = <2>;
		qcom,mdss-dsi-lane-map = <0>;
		qcom,mdss-dsi-bllp-eof-power-mode;
		qcom,mdss-dsi-bllp-power-mode;
		qcom,mdss-dsi-lane-0-state;
		qcom,mdss-dsi-lane-1-state;
		qcom,mdss-dsi-lane-2-state;
		qcom,mdss-dsi-lane-3-state;
		qcom,ulps-enabled = <1>;
		qcom,mdss-dsi-panel-timings = [68 18 0D 00 3A 3E 14 23 13 03 04 00];
		qcom,mdss-dsi-t-clk-post = <0x04>;
		qcom,mdss-dsi-t-clk-pre = <0x19>;
		qcom,mdss-dsi-bl-min-level = <1>;
		qcom,mdss-dsi-bl-max-level = <1023>;
		qcom,mdss-dsi-bl-pmic-control-type = "bl_ctrl_dcs";
		qcom,mdss-dsi-dma-trigger = <4>;
		qcom,mdss-dsi-mdp-trigger = <0>;
		qcom,mdss-dsi-lp11-init = <1>; //by focaltech suggestion
		qcom,mdss-dsi-reset-sequence = <1 2>, <0 1>, <1 6>;
	};
};
